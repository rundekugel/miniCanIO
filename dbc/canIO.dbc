VERSION ""

NS_ :

BS_:

BU_: CANIO

BO_ 185 CANIO_TX: 8 CANIO
 SG_ config_mux M : 0|8@1+ (1,0) [0|0] "Return message" CANIO
 SG_ config_unlock m192 : 8|8@1+ (1,0) [0|9] "lock level (0=unlocked)" CANIO
 SG_ config_data  m192 : 16|48@1+ (1,0) [0|4294967295] "6 bytes from key" CANIO
 SG_ config_block m207 :  8|8@1+ (1,0) [0|255] "block offset (6 bytes)" CANIO
 SG_ config_pos   m207 :  8|8@1+ (4,0) [0|255] "byte offset" CANIO

BO_ 187 CANIO_RX: 8 CANIO
 SG_ config_mux M : 0|8@1+ (1,0) [0|0] "Control message" CANIO
 SG_ config_unlock m192 : 8|48@1+ (1,0) [0|99999999] "key-array" CANIO
 SG_ config_data  m192 : 16|48@1+ (1,0) [0|4294967295] "6 bytes from key" CANIO
 SG_ config_block m207 :  8|8@1+ (1,0) [0|255] "read block offset (6 bytes)" CANIO
 SG_ config_pos   m207 :  8|8@1+ (4,0) [0|255] "read byte offset" CANIO
